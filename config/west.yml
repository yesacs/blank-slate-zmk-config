## config/west.yml
```yaml
manifest:
  remotes:
    - name: petejohanson
      url-base: https://github.com/petejohanson
    - name: zmkfirmware
      url-base: https://github.com/zmkfirmware
  projects:
    - name: zmk
      remote: petejohanson
      revision: 0c59d3e
      import: app/west.yml
    - name: blank-slate-zmk-module
      remote: petejohanson
      revision: main
  self:
    path: config
```
